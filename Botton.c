/*******************************************************************************
* Copyright 2016 HangZhou 杭州久天科技有限公司
* All right reserved
*
* 文件名称：button.h
*
* 文件标识：
* 摘    要：
*
*
* 当前版本：
* 作    者：lhb Steven
* 完成日期：2016/4/15
* 编译环境：C:\Program Files (x86)\IAR Systems\Embedded Workbench 6.5\stm8        
*
* 历史信息：
*******************************************************************************/
#include "Botton.h"
#define BUTTON_SWITCH   PD_IDR_IDR3  //开关
/**********************************************函数定义***************************************************** 
* 函数名称: void ButtonInit(void) 
* 输入参数: void 
* 返回参数: void  
* 功    能: csh  
* 作    者: by lhb_steven
* 日    期: 2016/4/15
************************************************************************************************************/ 
void ButtonInit(void) { 
    PD_DDR_DDR3 = 0;
    PD_CR1_C13 = 1;
    PD_CR2_C23 = 0;
}
/**********************************************函数定义***************************************************** 
* 函数名称: u8 ButtonRead(void) 
* 输入参数: void 
* 返回参数: u8  
* 功    能: 返回按键状态  
* 作    者: by lhb_steven
* 日    期: 2016/4/15
************************************************************************************************************/ 
u8 ButtonRead(void) { 
    static u16 count = 0;
    static u8 count_s = 0;
    if(count_s < 100) {
        count_s++;
    } else {
        count_s = 0;
        if(BUTTON_SWITCH == 0) {
            if(count < 5000) {
                count++;
                if(count == 5000) {
                    return 0x01;//长按进入
                }
            }
        } else {
            if( (count > 400) && (count < 5000) ) {
                count = 0;
                return 0x02;//短按进入
            }
            count = 0;
        }
    }
    return 0x00;
}







